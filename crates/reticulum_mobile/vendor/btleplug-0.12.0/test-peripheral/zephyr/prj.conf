## CMakeLists.txt
```
# SPDX-License-Identifier: Apache-2.0

cmake_minimum_required(VERSION 3.20.0)

find_package(Zephyr REQUIRED HINTS $ENV{ZEPHYR_BASE})
project(btleplug_test_peripheral)

target_sources(app PRIVATE
    src/main.c
    src/gatt_profile.c
    src/control_service.c
    src/test_handlers.c
)

target_include_directories(app PRIVATE src)
```

## prj.conf
```kconfig
# Bluetooth Core
CONFIG_BT=y
CONFIG_BT_PERIPHERAL=y

# Device Name
CONFIG_BT_DEVICE_NAME="btleplug-test"
CONFIG_BT_DEVICE_NAME_DYNAMIC=n

# GATT
CONFIG_BT_ATT_PREPARE_COUNT=5
CONFIG_BT_BUF_ACL_RX_SIZE=251
CONFIG_BT_BUF_ACL_TX_SIZE=251
CONFIG_BT_L2CAP_TX_MTU=247

# Logging (backend configured per-board in boards/*.conf)
CONFIG_LOG=y
CONFIG_BT_LOG_LEVEL_INF=y
CONFIG_CONSOLE=y

# System
CONFIG_SYSTEM_WORKQUEUE_STACK_SIZE=2048
CONFIG_HEAP_MEM_POOL_SIZE=4096
```

## boards/esp32s3_devkitc_esp32s3_procpu.conf
```kconfig
# Board-specific: ESP32-S3 DevKitC
# UART logging (default for ESP32)
CONFIG_LOG_BACKEND_UART=y
CONFIG_UART_CONSOLE=y
```

## boards/nrf52840dk_nrf52840.conf
```kconfig
# Board-specific: nRF52840 DK
# Enable Data Length Extension for larger MTU
CONFIG_BT_CTLR_DATA_LENGTH_MAX=251

# Segger RTT logging (UART is unreliable on this board)
CONFIG_USE_SEGGER_RTT=y
CONFIG_LOG_BACKEND_RTT=y
CONFIG_LOG_BACKEND_UART=n
CONFIG_RTT_CONSOLE=y
```

## src/main.c
```c
#include <zephyr/kernel.h>
#include <zephyr/bluetooth/bluetooth.h>
#include <zephyr/bluetooth/conn.h>
#include <zephyr/bluetooth/gatt.h>
#include <zephyr/bluetooth/gap.h>

#include "gatt_profile.h"

#include <zephyr/logging/log.h>
LOG_MODULE_REGISTER(main, LOG_LEVEL_INF);

/* Advertisement data:
 * - Flags: General Discoverable + BR/EDR Not Supported
 * - Complete device name: "btleplug-test"
 * - Manufacturer data: Company ID 0xFFFF + [0xBB, 0xTT, 0x01]
 */
static const struct bt_data ad[] = {
	BT_DATA_BYTES(BT_DATA_FLAGS, (BT_LE_AD_GENERAL | BT_LE_AD_NO_BREDR)),
	BT_DATA(BT_DATA_NAME_COMPLETE, CONFIG_BT_DEVICE_NAME,
		sizeof(CONFIG_BT_DEVICE_NAME) - 1),
	BT_DATA_BYTES(BT_DATA_MANUFACTURER_DATA,
		0xFF, 0xFF,       /* Company ID 0xFFFF (little-endian) */
		0xBB, 0xCC, 0x01  /* "bt" + version */
	),
	BT_DATA_BYTES(BT_DATA_TX_POWER, 0x00),  /* TX Power Level: 0 dBm */
};

/* Scan response data:
 * - 128-bit service UUID list (triggers ServicesAdvertisement in btleplug)
 */
static const struct bt_data sd[] = {
	BT_DATA_BYTES(BT_DATA_UUID128_ALL,
		/* Control Service UUID (little-endian) */
		0x9e, 0xca, 0xdc, 0x24, 0x0e, 0xe5, 0xa9, 0xe0,
		0x93, 0xf3, 0xa3, 0xb5, 0x01, 0x00, 0x00, 0x00
	),
};

static void connected(struct bt_conn *conn, uint8_t err)
{
	if (err) {
		LOG_ERR("Connection failed (err 0x%02x)", err);
		return;
	}

	LOG_INF("Connected");
	g_state.conn = bt_conn_ref(conn);
}

static void restart_adv_work_handler(struct k_work *work);
static K_WORK_DELAYABLE_DEFINE(restart_adv_work, restart_adv_work_handler);

static void restart_adv_work_handler(struct k_work *work)
{
	/* Ensure advertising is stopped before restarting */
	bt_le_adv_stop();

	int err = bt_le_adv_start(BT_LE_ADV_CONN_FAST_1, ad, ARRAY_SIZE(ad),
				   sd, ARRAY_SIZE(sd));
	if (err) {
		LOG_ERR("Advertising restart failed (err %d)", err);
	} else {
		LOG_INF("Advertising restarted");
	}
}

static void disconnected(struct bt_conn *conn, uint8_t reason)
{
	LOG_INF("Disconnected (reason 0x%02x)", reason);

	if (g_state.conn) {
		bt_conn_unref(g_state.conn);
		g_state.conn = NULL;
	}

	stop_periodic_notifications();

	/* Defer advertising restart to system workqueue to avoid
	 * calling bt_le_adv_start from the connection callback context,
	 * which can fail on some Zephyr BLE controller configurations. */
	k_work_reschedule(&restart_adv_work, K_MSEC(100));
}

BT_CONN_CB_DEFINE(conn_callbacks) = {
	.connected = connected,
	.disconnected = disconnected,
};

int main(void)
{
	int err;

	LOG_INF("btleplug test peripheral starting");

	control_service_init();

	err = bt_enable(NULL);
	if (err) {
		LOG_ERR("Bluetooth init failed (err %d)", err);
		return 0;
	}

	LOG_INF("Bluetooth initialized");

	err = bt_le_adv_start(BT_LE_ADV_CONN_FAST_1, ad, ARRAY_SIZE(ad),
			       sd, ARRAY_SIZE(sd));
	if (err) {
		LOG_ERR("Advertising failed to start (err %d)", err);
		return 0;
	}

	LOG_INF("Advertising as '%s'", CONFIG_BT_DEVICE_NAME);

	/* Main thread sleeps — all work is done in callbacks and workqueue */
	while (1) {
		k_sleep(K_FOREVER);
	}

	return 0;
}
```

## src/control_service.c
```c
#include <zephyr/kernel.h>
#include <zephyr/bluetooth/bluetooth.h>
#include <zephyr/bluetooth/conn.h>
#include <zephyr/bluetooth/gatt.h>
#include <string.h>

#include "gatt_profile.h"

#include <zephyr/logging/log.h>
LOG_MODULE_REGISTER(control_service, LOG_LEVEL_INF);

/* Global peripheral state */
struct peripheral_state g_state;

/* Notification work item for periodic notifications */
static struct k_work_delayable notify_work;
static bool periodic_notify_active;

/* Reference to notify service attributes for bt_gatt_notify() */
extern struct bt_gatt_service_static notify_svc;

static void periodic_notify_handler(struct k_work *work)
{
	if (!periodic_notify_active || !g_state.conn) {
		return;
	}

	/*
	 * Attribute indices in notify_svc (BT_GATT_SERVICE_DEFINE layout):
	 *   [0] = Primary Service declaration
	 *   [1] = Notify Char declaration
	 *   [2] = Notify Char value  <-- use for bt_gatt_notify
	 *   [3] = Notify CCC
	 *   [4] = Indicate Char declaration
	 *   [5] = Indicate Char value  <-- use for bt_gatt_indicate
	 *   [6] = Indicate CCC
	 *   [7] = Configurable Notify declaration
	 *   [8] = Configurable Notify value  <-- use for bt_gatt_notify
	 *   [9] = Configurable Notify CCC
	 */

	/* Send notification on Notify Char (attr index 2 = value attribute) */
	if (g_state.notify_enabled) {
		static uint8_t counter;
		uint8_t data[] = {counter++};
		bt_gatt_notify(g_state.conn, &notify_svc.attrs[2], data, sizeof(data));
	}

	/* Send indication on Indicate Char (attr index 5 = value attribute) */
	if (g_state.indicate_enabled) {
		static struct bt_gatt_indicate_params ind_params;
		static uint8_t ind_counter;
		uint8_t data[] = {ind_counter++};
		ind_params.attr = &notify_svc.attrs[5];
		ind_params.func = NULL;
		ind_params.destroy = NULL;
		ind_params.data = data;
		ind_params.len = sizeof(data);
		bt_gatt_indicate(g_state.conn, &ind_params);
	}

	/* Send configurable notify (attr index 8 = value attribute) */
	if (g_state.configurable_notify_enabled && g_state.notify_payload_len > 0) {
		bt_gatt_notify(g_state.conn, &notify_svc.attrs[8],
			       g_state.notify_payload, g_state.notify_payload_len);
	}

	/* Reschedule */
	k_work_reschedule(&notify_work, K_MSEC(NOTIFICATION_INTERVAL_MS));
}

void start_periodic_notifications(void)
{
	periodic_notify_active = true;
	k_work_reschedule(&notify_work, K_MSEC(NOTIFICATION_INTERVAL_MS));
	LOG_INF("Periodic notifications started");
}

void stop_periodic_notifications(void)
{
	periodic_notify_active = false;
	k_work_cancel_delayable(&notify_work);
	LOG_INF("Periodic notifications stopped");
}

void reset_peripheral_state(void)
{
	stop_periodic_notifications();
	g_state.read_counter = 0;
	g_state.rw_value_len = 0;
	g_state.long_value_len = 0;
	g_state.write_with_resp_len = 0;
	g_state.notify_payload_len = 0;
	g_state.rw_descriptor_len = 0;
	memset(g_state.rw_value, 0, sizeof(g_state.rw_value));
	memset(g_state.long_value, 0, sizeof(g_state.long_value));
	memset(g_state.write_with_resp_value, 0, sizeof(g_state.write_with_resp_value));
	memset(g_state.notify_payload, 0, sizeof(g_state.notify_payload));
	memset(g_state.rw_descriptor_value, 0, sizeof(g_state.rw_descriptor_value));
	LOG_INF("Peripheral state reset");
}

/* Disconnect work — delayed to allow the write response to be sent */
static struct k_work_delayable disconnect_work;

static void disconnect_handler(struct k_work *work)
{
	if (g_state.conn) {
		bt_conn_disconnect(g_state.conn, BT_HCI_ERR_REMOTE_USER_TERM_CONN);
	}
}

void control_handle_command(const uint8_t *data, uint16_t len)
{
	if (len < 1) {
		LOG_WRN("Empty control command");
		return;
	}

	uint8_t opcode = data[0];
	LOG_INF("Control command: 0x%02x", opcode);

	switch (opcode) {
	case CMD_START_NOTIFICATIONS:
		start_periodic_notifications();
		break;
	case CMD_STOP_NOTIFICATIONS:
		stop_periodic_notifications();
		break;
	case CMD_TRIGGER_DISCONNECT:
		k_work_reschedule(&disconnect_work, K_MSEC(500));
		break;
	case CMD_CHANGE_ADVERTISEMENTS:
		/* Deferred: advertisement rotation is not tested in the initial
		 * integration test suite. Implement when CentralEvent::ServiceDataAdvertisement
		 * tests are added. */
		LOG_INF("Change advertisements (deferred — not tested in initial suite)");
		break;
	case CMD_RESET_STATE:
		reset_peripheral_state();
		break;
	case CMD_SET_NOTIFICATION_PAYLOAD:
		if (len > 1) {
			uint16_t payload_len = len - 1;
			if (payload_len > sizeof(g_state.notify_payload)) {
				payload_len = sizeof(g_state.notify_payload);
			}
			memcpy(g_state.notify_payload, &data[1], payload_len);
			g_state.notify_payload_len = payload_len;
			LOG_INF("Notification payload set: %u bytes", payload_len);
		}
		break;
	default:
		LOG_WRN("Unknown control opcode: 0x%02x", opcode);
		break;
	}
}

/* GATT write handler for Control Point */
ssize_t write_control_point(struct bt_conn *conn,
			    const struct bt_gatt_attr *attr,
			    const void *buf, uint16_t len,
			    uint16_t offset, uint8_t flags)
{
	control_handle_command(buf, len);
	return len;
}

/* Control Response CCC changed */
void control_response_ccc_changed(const struct bt_gatt_attr *attr, uint16_t value)
{
	LOG_INF("Control Response CCC: 0x%04x", value);
}

void control_service_init(void)
{
	k_work_init_delayable(&notify_work, periodic_notify_handler);
	k_work_init_delayable(&disconnect_work, disconnect_handler);
	reset_peripheral_state();
}
```

## src/gatt_profile.c
```c
#include <zephyr/bluetooth/bluetooth.h>
#include <zephyr/bluetooth/gatt.h>

#include "gatt_profile.h"

/* Forward declarations for callbacks in test_handlers.c */
extern ssize_t read_static(struct bt_conn *, const struct bt_gatt_attr *,
                           void *, uint16_t, uint16_t);
extern ssize_t read_counter(struct bt_conn *, const struct bt_gatt_attr *,
                            void *, uint16_t, uint16_t);
extern ssize_t write_with_resp(struct bt_conn *, const struct bt_gatt_attr *,
                               const void *, uint16_t, uint16_t, uint8_t);
extern ssize_t write_without_resp(struct bt_conn *, const struct bt_gatt_attr *,
                                  const void *, uint16_t, uint16_t, uint8_t);
extern ssize_t read_rw(struct bt_conn *, const struct bt_gatt_attr *,
                       void *, uint16_t, uint16_t);
extern ssize_t write_rw(struct bt_conn *, const struct bt_gatt_attr *,
                        const void *, uint16_t, uint16_t, uint8_t);
extern ssize_t read_long_value(struct bt_conn *, const struct bt_gatt_attr *,
                               void *, uint16_t, uint16_t);
extern ssize_t write_long_value(struct bt_conn *, const struct bt_gatt_attr *,
                                const void *, uint16_t, uint16_t, uint8_t);
extern ssize_t read_descriptor_test_char(struct bt_conn *,
                                         const struct bt_gatt_attr *,
                                         void *, uint16_t, uint16_t);
extern ssize_t read_ro_descriptor(struct bt_conn *, const struct bt_gatt_attr *,
                                  void *, uint16_t, uint16_t);
extern ssize_t read_rw_descriptor(struct bt_conn *, const struct bt_gatt_attr *,
                                  void *, uint16_t, uint16_t);
extern ssize_t write_rw_descriptor(struct bt_conn *, const struct bt_gatt_attr *,
                                   const void *, uint16_t, uint16_t, uint8_t);
extern void notify_ccc_changed(const struct bt_gatt_attr *, uint16_t);
extern void indicate_ccc_changed(const struct bt_gatt_attr *, uint16_t);
extern void configurable_notify_ccc_changed(const struct bt_gatt_attr *, uint16_t);

/* Forward declaration for control point write handler */
extern ssize_t write_control_point(struct bt_conn *, const struct bt_gatt_attr *,
                                   const void *, uint16_t, uint16_t, uint8_t);
extern void control_response_ccc_changed(const struct bt_gatt_attr *, uint16_t);

/* ============================================================
 * Service 1: Control Service
 * ============================================================ */
BT_GATT_SERVICE_DEFINE(control_svc,
    BT_GATT_PRIMARY_SERVICE(BT_UUID_CONTROL_SERVICE),
    /* Control Point — Write */
    BT_GATT_CHARACTERISTIC(BT_UUID_CONTROL_POINT,
        BT_GATT_CHRC_WRITE,
        BT_GATT_PERM_WRITE,
        NULL, write_control_point, NULL),
    /* Control Response — Notify */
    BT_GATT_CHARACTERISTIC(BT_UUID_CONTROL_RESPONSE,
        BT_GATT_CHRC_NOTIFY,
        BT_GATT_PERM_NONE,
        NULL, NULL, NULL),
    BT_GATT_CCC(control_response_ccc_changed,
        BT_GATT_PERM_READ | BT_GATT_PERM_WRITE),
);

/* ============================================================
 * Service 2: Read/Write Test Service
 * ============================================================ */
BT_GATT_SERVICE_DEFINE(rw_svc,
    BT_GATT_PRIMARY_SERVICE(BT_UUID_RW_SERVICE),
    /* Static Read */
    BT_GATT_CHARACTERISTIC(BT_UUID_STATIC_READ,
        BT_GATT_CHRC_READ,
        BT_GATT_PERM_READ,
        read_static, NULL, NULL),
    /* Counter Read */
    BT_GATT_CHARACTERISTIC(BT_UUID_COUNTER_READ,
        BT_GATT_CHRC_READ,
        BT_GATT_PERM_READ,
        read_counter, NULL, NULL),
    /* Write With Response */
    BT_GATT_CHARACTERISTIC(BT_UUID_WRITE_WITH_RESP,
        BT_GATT_CHRC_WRITE,
        BT_GATT_PERM_WRITE,
        NULL, write_with_resp, NULL),
    /* Write Without Response */
    BT_GATT_CHARACTERISTIC(BT_UUID_WRITE_WITHOUT_RESP,
        BT_GATT_CHRC_WRITE_WITHOUT_RESP,
        BT_GATT_PERM_WRITE,
        NULL, write_without_resp, NULL),
    /* Read/Write */
    BT_GATT_CHARACTERISTIC(BT_UUID_READ_WRITE,
        BT_GATT_CHRC_READ | BT_GATT_CHRC_WRITE,
        BT_GATT_PERM_READ | BT_GATT_PERM_WRITE,
        read_rw, write_rw, NULL),
    /* Long Value (512 bytes) */
    BT_GATT_CHARACTERISTIC(BT_UUID_LONG_VALUE,
        BT_GATT_CHRC_READ | BT_GATT_CHRC_WRITE,
        BT_GATT_PERM_READ | BT_GATT_PERM_WRITE,
        read_long_value, write_long_value, NULL),
);

/* ============================================================
 * Service 3: Notification Test Service
 * ============================================================ */
BT_GATT_SERVICE_DEFINE(notify_svc,
    BT_GATT_PRIMARY_SERVICE(BT_UUID_NOTIFY_SERVICE),
    /* Notify Char */
    BT_GATT_CHARACTERISTIC(BT_UUID_NOTIFY_CHAR,
        BT_GATT_CHRC_NOTIFY,
        BT_GATT_PERM_NONE,
        NULL, NULL, NULL),
    BT_GATT_CCC(notify_ccc_changed,
        BT_GATT_PERM_READ | BT_GATT_PERM_WRITE),
    /* Indicate Char */
    BT_GATT_CHARACTERISTIC(BT_UUID_INDICATE_CHAR,
        BT_GATT_CHRC_INDICATE,
        BT_GATT_PERM_NONE,
        NULL, NULL, NULL),
    BT_GATT_CCC(indicate_ccc_changed,
        BT_GATT_PERM_READ | BT_GATT_PERM_WRITE),
    /* Configurable Notify */
    BT_GATT_CHARACTERISTIC(BT_UUID_CONFIGURABLE_NOTIFY,
        BT_GATT_CHRC_NOTIFY,
        BT_GATT_PERM_NONE,
        NULL, NULL, NULL),
    BT_GATT_CCC(configurable_notify_ccc_changed,
        BT_GATT_PERM_READ | BT_GATT_PERM_WRITE),
);

/* ============================================================
 * Service 4: Descriptor Test Service
 * ============================================================ */
BT_GATT_SERVICE_DEFINE(descriptor_svc,
    BT_GATT_PRIMARY_SERVICE(BT_UUID_DESCRIPTOR_SERVICE),
    /* Descriptor Test Char — Read, with custom descriptors */
    BT_GATT_CHARACTERISTIC(BT_UUID_DESCRIPTOR_TEST_CHAR,
        BT_GATT_CHRC_READ,
        BT_GATT_PERM_READ,
        read_descriptor_test_char, NULL, NULL),
    /* Read-Only Descriptor */
    BT_GATT_DESCRIPTOR(BT_UUID_READ_ONLY_DESCRIPTOR,
        BT_GATT_PERM_READ,
        read_ro_descriptor, NULL, NULL),
    /* Read/Write Descriptor */
    BT_GATT_DESCRIPTOR(BT_UUID_RW_DESCRIPTOR,
        BT_GATT_PERM_READ | BT_GATT_PERM_WRITE,
        read_rw_descriptor, write_rw_descriptor, NULL),
);
```

## src/gatt_profile.h
```c
#ifndef GATT_PROFILE_H_
#define GATT_PROFILE_H_

#include <zephyr/bluetooth/uuid.h>

/*
 * btleplug Test GATT Profile
 * Base UUID: XXXXXXXX-b5a3-f393-e0a9-e50e24dcca9e
 */

/* --- Control Service (0x00000001-...) --- */
#define BT_UUID_CONTROL_SERVICE \
    BT_UUID_DECLARE_128(BT_UUID_128_ENCODE(0x00000001, 0xb5a3, 0xf393, 0xe0a9, 0xe50e24dcca9e))
#define BT_UUID_CONTROL_POINT \
    BT_UUID_DECLARE_128(BT_UUID_128_ENCODE(0x00000101, 0xb5a3, 0xf393, 0xe0a9, 0xe50e24dcca9e))
#define BT_UUID_CONTROL_RESPONSE \
    BT_UUID_DECLARE_128(BT_UUID_128_ENCODE(0x00000102, 0xb5a3, 0xf393, 0xe0a9, 0xe50e24dcca9e))

/* --- Read/Write Test Service (0x00000002-...) --- */
#define BT_UUID_RW_SERVICE \
    BT_UUID_DECLARE_128(BT_UUID_128_ENCODE(0x00000002, 0xb5a3, 0xf393, 0xe0a9, 0xe50e24dcca9e))
#define BT_UUID_STATIC_READ \
    BT_UUID_DECLARE_128(BT_UUID_128_ENCODE(0x00000201, 0xb5a3, 0xf393, 0xe0a9, 0xe50e24dcca9e))
#define BT_UUID_COUNTER_READ \
    BT_UUID_DECLARE_128(BT_UUID_128_ENCODE(0x00000202, 0xb5a3, 0xf393, 0xe0a9, 0xe50e24dcca9e))
#define BT_UUID_WRITE_WITH_RESP \
    BT_UUID_DECLARE_128(BT_UUID_128_ENCODE(0x00000203, 0xb5a3, 0xf393, 0xe0a9, 0xe50e24dcca9e))
#define BT_UUID_WRITE_WITHOUT_RESP \
    BT_UUID_DECLARE_128(BT_UUID_128_ENCODE(0x00000204, 0xb5a3, 0xf393, 0xe0a9, 0xe50e24dcca9e))
#define BT_UUID_READ_WRITE \
    BT_UUID_DECLARE_128(BT_UUID_128_ENCODE(0x00000205, 0xb5a3, 0xf393, 0xe0a9, 0xe50e24dcca9e))
#define BT_UUID_LONG_VALUE \
    BT_UUID_DECLARE_128(BT_UUID_128_ENCODE(0x00000206, 0xb5a3, 0xf393, 0xe0a9, 0xe50e24dcca9e))

/* --- Notification Test Service (0x00000003-...) --- */
#define BT_UUID_NOTIFY_SERVICE \
    BT_UUID_DECLARE_128(BT_UUID_128_ENCODE(0x00000003, 0xb5a3, 0xf393, 0xe0a9, 0xe50e24dcca9e))
#define BT_UUID_NOTIFY_CHAR \
    BT_UUID_DECLARE_128(BT_UUID_128_ENCODE(0x00000301, 0xb5a3, 0xf393, 0xe0a9, 0xe50e24dcca9e))
#define BT_UUID_INDICATE_CHAR \
    BT_UUID_DECLARE_128(BT_UUID_128_ENCODE(0x00000302, 0xb5a3, 0xf393, 0xe0a9, 0xe50e24dcca9e))
#define BT_UUID_CONFIGURABLE_NOTIFY \
    BT_UUID_DECLARE_128(BT_UUID_128_ENCODE(0x00000303, 0xb5a3, 0xf393, 0xe0a9, 0xe50e24dcca9e))

/* --- Descriptor Test Service (0x00000004-...) --- */
#define BT_UUID_DESCRIPTOR_SERVICE \
    BT_UUID_DECLARE_128(BT_UUID_128_ENCODE(0x00000004, 0xb5a3, 0xf393, 0xe0a9, 0xe50e24dcca9e))
#define BT_UUID_DESCRIPTOR_TEST_CHAR \
    BT_UUID_DECLARE_128(BT_UUID_128_ENCODE(0x00000401, 0xb5a3, 0xf393, 0xe0a9, 0xe50e24dcca9e))
#define BT_UUID_READ_ONLY_DESCRIPTOR \
    BT_UUID_DECLARE_128(BT_UUID_128_ENCODE(0x000004A1, 0xb5a3, 0xf393, 0xe0a9, 0xe50e24dcca9e))
#define BT_UUID_RW_DESCRIPTOR \
    BT_UUID_DECLARE_128(BT_UUID_128_ENCODE(0x000004A2, 0xb5a3, 0xf393, 0xe0a9, 0xe50e24dcca9e))

/* --- Control Point Opcodes --- */
#define CMD_START_NOTIFICATIONS  0x01
#define CMD_STOP_NOTIFICATIONS   0x02
#define CMD_TRIGGER_DISCONNECT   0x03
#define CMD_CHANGE_ADVERTISEMENTS 0x04
#define CMD_RESET_STATE          0x05
#define CMD_SET_NOTIFICATION_PAYLOAD 0x06

/* --- Test Constants --- */
#define STATIC_READ_VALUE        {0x01, 0x02, 0x03, 0x04}
#define LONG_VALUE_SIZE          512
#define MANUFACTURER_COMPANY_ID  0xFFFF
#define NOTIFICATION_INTERVAL_MS 1000

/* --- Shared State --- */

/** Peripheral state accessible from all modules. */
struct peripheral_state {
    struct bt_conn *conn;
    bool notify_enabled;
    bool indicate_enabled;
    bool configurable_notify_enabled;
    uint32_t read_counter;
    uint8_t rw_value[256];
    uint16_t rw_value_len;
    uint8_t long_value[LONG_VALUE_SIZE];
    uint16_t long_value_len;
    uint8_t write_with_resp_value[256];
    uint16_t write_with_resp_len;
    uint8_t notify_payload[20];
    uint16_t notify_payload_len;
    uint8_t rw_descriptor_value[256];
    uint16_t rw_descriptor_len;
};

extern struct peripheral_state g_state;

/* --- Functions shared across modules --- */
void control_service_init(void);
void control_handle_command(const uint8_t *data, uint16_t len);
void start_periodic_notifications(void);
void stop_periodic_notifications(void);
void reset_peripheral_state(void);

#endif /* GATT_PROFILE_H_ */
```

## src/test_handlers.c
```c
#include <zephyr/kernel.h>
#include <zephyr/bluetooth/bluetooth.h>
#include <zephyr/bluetooth/gatt.h>
#include <string.h>

#include "gatt_profile.h"

#include <zephyr/logging/log.h>
LOG_MODULE_REGISTER(test_handlers, LOG_LEVEL_INF);

/* Static read value — always returns [0x01, 0x02, 0x03, 0x04] */
static const uint8_t static_read_val[] = STATIC_READ_VALUE;

/* --- Read/Write Test Service Callbacks --- */

ssize_t read_static(struct bt_conn *conn, const struct bt_gatt_attr *attr,
                    void *buf, uint16_t len, uint16_t offset)
{
    return bt_gatt_attr_read(conn, attr, buf, len, offset,
                             static_read_val, sizeof(static_read_val));
}

ssize_t read_counter(struct bt_conn *conn, const struct bt_gatt_attr *attr,
                     void *buf, uint16_t len, uint16_t offset)
{
    uint32_t counter = g_state.read_counter++;
    uint8_t data[4] = {
        (uint8_t)(counter & 0xFF),
        (uint8_t)((counter >> 8) & 0xFF),
        (uint8_t)((counter >> 16) & 0xFF),
        (uint8_t)((counter >> 24) & 0xFF),
    };
    return bt_gatt_attr_read(conn, attr, buf, len, offset, data, sizeof(data));
}

ssize_t write_with_resp(struct bt_conn *conn, const struct bt_gatt_attr *attr,
                        const void *buf, uint16_t len, uint16_t offset,
                        uint8_t flags)
{
    if (offset + len > sizeof(g_state.write_with_resp_value)) {
        return BT_GATT_ERR(BT_ATT_ERR_INVALID_OFFSET);
    }
    memcpy(g_state.write_with_resp_value + offset, buf, len);
    g_state.write_with_resp_len = offset + len;
    LOG_INF("Write with response: %u bytes", len);
    return len;
}

ssize_t write_without_resp(struct bt_conn *conn, const struct bt_gatt_attr *attr,
                           const void *buf, uint16_t len, uint16_t offset,
                           uint8_t flags)
{
    if (offset + len > sizeof(g_state.rw_value)) {
        return BT_GATT_ERR(BT_ATT_ERR_INVALID_OFFSET);
    }
    /*
     * Write-without-response stores to rw_value so the Rust test can
     * verify receipt by reading back through the Read/Write characteristic.
     */
    memcpy(g_state.rw_value + offset, buf, len);
    g_state.rw_value_len = offset + len;
    LOG_INF("Write without response: %u bytes", len);
    return len;
}

ssize_t read_rw(struct bt_conn *conn, const struct bt_gatt_attr *attr,
                void *buf, uint16_t len, uint16_t offset)
{
    return bt_gatt_attr_read(conn, attr, buf, len, offset,
                             g_state.rw_value, g_state.rw_value_len);
}

ssize_t write_rw(struct bt_conn *conn, const struct bt_gatt_attr *attr,
                 const void *buf, uint16_t len, uint16_t offset,
                 uint8_t flags)
{
    if (offset + len > sizeof(g_state.rw_value)) {
        return BT_GATT_ERR(BT_ATT_ERR_INVALID_OFFSET);
    }
    memcpy(g_state.rw_value + offset, buf, len);
    g_state.rw_value_len = offset + len;
    LOG_INF("Read/Write char written: %u bytes", len);
    return len;
}

ssize_t read_long_value(struct bt_conn *conn, const struct bt_gatt_attr *attr,
                        void *buf, uint16_t len, uint16_t offset)
{
    return bt_gatt_attr_read(conn, attr, buf, len, offset,
                             g_state.long_value, g_state.long_value_len);
}

ssize_t write_long_value(struct bt_conn *conn, const struct bt_gatt_attr *attr,
                         const void *buf, uint16_t len, uint16_t offset,
                         uint8_t flags)
{
    if (offset + len > sizeof(g_state.long_value)) {
        return BT_GATT_ERR(BT_ATT_ERR_INVALID_OFFSET);
    }
    memcpy(g_state.long_value + offset, buf, len);
    if (offset + len > g_state.long_value_len) {
        g_state.long_value_len = offset + len;
    }
    LOG_INF("Long value written: %u bytes at offset %u", len, offset);
    return len;
}

/* --- Descriptor Test Service Callbacks --- */

static const uint8_t read_only_descriptor_val[] = {0xDE, 0xAD, 0xBE, 0xEF};

ssize_t read_ro_descriptor(struct bt_conn *conn, const struct bt_gatt_attr *attr,
                           void *buf, uint16_t len, uint16_t offset)
{
    return bt_gatt_attr_read(conn, attr, buf, len, offset,
                             read_only_descriptor_val,
                             sizeof(read_only_descriptor_val));
}

ssize_t read_rw_descriptor(struct bt_conn *conn, const struct bt_gatt_attr *attr,
                           void *buf, uint16_t len, uint16_t offset)
{
    return bt_gatt_attr_read(conn, attr, buf, len, offset,
                             g_state.rw_descriptor_value,
                             g_state.rw_descriptor_len);
}

ssize_t write_rw_descriptor(struct bt_conn *conn, const struct bt_gatt_attr *attr,
                            const void *buf, uint16_t len, uint16_t offset,
                            uint8_t flags)
{
    if (offset + len > sizeof(g_state.rw_descriptor_value)) {
        return BT_GATT_ERR(BT_ATT_ERR_INVALID_OFFSET);
    }
    memcpy(g_state.rw_descriptor_value + offset, buf, len);
    g_state.rw_descriptor_len = offset + len;
    LOG_INF("R/W descriptor written: %u bytes", len);
    return len;
}

/* --- Descriptor Test Char (parent) --- */

ssize_t read_descriptor_test_char(struct bt_conn *conn,
                                  const struct bt_gatt_attr *attr,
                                  void *buf, uint16_t len, uint16_t offset)
{
    static const uint8_t val[] = {0x00};
    return bt_gatt_attr_read(conn, attr, buf, len, offset, val, sizeof(val));
}

/* --- Notification CCC Callbacks --- */

void notify_ccc_changed(const struct bt_gatt_attr *attr, uint16_t value)
{
    g_state.notify_enabled = (value == BT_GATT_CCC_NOTIFY);
    LOG_INF("Notify CCC: %s", g_state.notify_enabled ? "enabled" : "disabled");
}

void indicate_ccc_changed(const struct bt_gatt_attr *attr, uint16_t value)
{
    g_state.indicate_enabled = (value == BT_GATT_CCC_INDICATE);
    LOG_INF("Indicate CCC: %s", g_state.indicate_enabled ? "enabled" : "disabled");
}

void configurable_notify_ccc_changed(const struct bt_gatt_attr *attr, uint16_t value)
{
    g_state.configurable_notify_enabled = (value == BT_GATT_CCC_NOTIFY);
    LOG_INF("Configurable Notify CCC: %s",
            g_state.configurable_notify_enabled ? "enabled" : "disabled");
}
```
